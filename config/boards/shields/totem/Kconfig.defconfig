## config/boards/shields/totem/Kconfig.defconfig
```kconfig
if SHIELD_HANDWIRED_SPLIT_LEFT || SHIELD_HANDWIRED_SPLIT_RIGHT
    config ZMK_SPLIT
        default y
endif

if SHIELD_HANDWIRED_SPLIT_LEFT
    config ZMK_SPLIT_ROLE_PERIPHERAL
        default y
endif

if SHIELD_HANDWIRED_SPLIT_RIGHT
    config ZMK_SPLIT_ROLE_CENTRAL
        default y
endif

if SHIELD_HANDWIRED_SPLIT_LEFT || SHIELD_HANDWIRED_SPLIT_RIGHT
    config ZMK_KEYBOARD_NAME
        default "Handwired"
    # EC11(노브) 드라이버 활성화
    config CONFIG_EC11
        default y
    config CONFIG_EC11_TRIGGER_GLOBAL_THREAD
        default y
endif
```

## config/boards/shields/totem/Kconfig.shield
```kconfig
menu "My Split Keyboard Shields"

config SHIELD_HANDWIRED_SPLIT_LEFT
    bool "handwired_split_left"
    default $(shields_list_contains,handwired_split_left)

config SHIELD_HANDWIRED_SPLIT_RIGHT
    bool "handwired_split_right"
    default $(shields_list_contains,handwired_split_right)

endmenu
```
